## dts/bindings/neural_net/intel,gna34.yaml
```yaml
# Copyright (c) 2023 Intel Corporation
#
# SPDX-License-Identifier: Apache-2.0

description: Intel Gaussian Mixture Model and Neural Network Accelerator (GNA)

compatible: "intel,gna34"

include: [base.yaml]

properties:
  reg:
    required: true

  interrupts:
    required: true

  interrupt-parent:
    required: true
```

## src/audio/nld/Kconfig
```kconfig
config COMP_NOISE_LEVEL_DETECTOR
	bool "Noise Level component"
	default n
	help
	  Enable Noise Level Detector (NLD) component.
	  The module is able to compute nosie level in audio stream.
```

## src/lib/inference/Kconfig
```kconfig
# SPDX-License-Identifier: BSD-3-Clause

if INFERENCE_SERVICE

if ACE_VERSION_1_5
	config GNA_HW_VER_35
		bool "GNA 3.5 hardware"
		default y
		help
			This option is used to Enable GNA 3.5 hardware for Inference Service.
endif

if ACE_VERSION_2_0
	config GNA_HW_VER_36
		bool "GNA 3.6 hardware"
		default y
		help
			This option is used to Enable GNA 3.6 hardware for Inference Service.
endif

if ACE_VERSION_3_0
	config GNA_HW_VER_40
		bool "GNA 4.0 hardware"
		default y
		help
			This option is used to Enable GNA 4.0 hardware for Inference Service.
endif

endif # INFERENCE_SERVICE
```

## test/ztest/unit/dsrc/testcase.yaml
```yaml
# SPDX-License-Identifier: BSD-3-Clause
#
# Copyright(c) 2026 Intel Corporation. All rights reserved.

tests:
  sof.unit.dsrc:
    tags: dsrc resampling audio
    platform_allow: native_sim
    integration_platforms:
      - native_sim
    build_only: false
```

## test/ztest/unit/esrc/testcase.yaml
```yaml
# SPDX-License-Identifier: BSD-3-Clause
#
# Copyright(c) 2026 Intel Corporation. All rights reserved.

tests:
  sof.unit.esrc:
    tags: esrc resampling audio
    platform_allow: native_sim
    integration_platforms:
      - native_sim
    build_only: false
```

## zephyr/drivers/neural_net/intel_gna34/Kconfig.intel_gna34
```kconfig
# Neural network accelerator driver configuration options

# Copyright (c) 2018 Intel Corporation
# SPDX-License-Identifier: Apache-2.0

menuconfig INTEL_GNA34
	bool "Intel GNA Inferencing Engine 3.x 4.x"
	default y
	depends on DT_HAS_INTEL_GNA34_ENABLED
	help
	  Enable support for Intel's GMM and Neural Network Accelerator version 3.x and 4.x

if INTEL_GNA34

config INTEL_GNA34_INIT_PRIORITY
	int "Init priority"
	default 99
	help
	  Device driver initialization priority.

config INTEL_GNA34_MAX_MODELS
	int "Max number of neural network models supported by driver"
	default 8
	help
	  Max. number of unique neural network models required in the system

config INTEL_GNA34_MAX_PENDING_REQUESTS
	int "Max number of pending inference requests"
	default 8
	help
	  Maximum number of pending inference requests in the driver

config INTEL_GNA34_6BAR
	bool "Intel GNA HW supports 4 or 6 BAR registers, Y for 6 BAR"
	default n
	help
	  This sholud be (n) for MTL and (y) for LNL, PTL

config INTEL_GNA34_7BAR
	bool "Intel GNA HW supports 7 BAR registers (GNA 4.5+)"
	default n
	depends on INTEL_GNA34_6BAR
	help
	  This should be (y) for NVL and newer platforms with GNA 4.5+.
	  Adds BAR5 for LDT and MLMT registers for memory protection.

config INTEL_GNA34_ACC_CTL
	bool "Intel GNA HW supports memory access control (GNA 4.5+)"
	default n
	depends on INTEL_GNA34_7BAR
	help
	  Enables GNA memory access control policy (GNA_ACC_CTL).
	  Each MBAR gets Read/Write/Execute privilege bits and MLMT
	  registers enforce memory region size limits.

config INTEL_GNA34_SHARED
	bool "Intel GNA34 driver can be used by multiple modules"
	default n
	help
	  (n) for single user or (y) for multiple users

config INTEL_GNA34_HW_STATS
	bool "Intel GNA HW - enable capturing HW statistics for inference"
	default y
	help
	  GNA HW statistics counters are anabled and results are passed
	  to requestor at the end of inference.


endif # INTEL_GNA34
```
